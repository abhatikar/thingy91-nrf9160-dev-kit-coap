## CMakeLists.txt
```
# SPDX-License-Identifier: Apache-2.0

cmake_minimum_required(VERSION 3.13.1)

list(APPEND mcuboot_OVERLAY_CONFIG
  "${CMAKE_CURRENT_SOURCE_DIR}/mcuboot_overlay-rsa.conf"
  )

find_package(Zephyr REQUIRED HINTS $ENV{ZEPHYR_BASE})
project(telenor_mic_coap)

FILE(GLOB app_sources src/*.c)
target_sources(app PRIVATE ${app_sources})
zephyr_include_directories(src)
```

## Kconfig
```
menu "Telenor Managed IoT Cloud CoAP Application"

config COAP_SERVER_IP
	string "CoAP server IP address"
	default "172.16.32.1"

config COAP_SERVER_PORT
	int "CoAP server port"
	default 5683

endmenu

menu "Sensors"

config CONFIG_BME680
	bool "Use BME680 (environment) sensor"
	default y if BOARD_THINGY91_NRF9160NS

config CONFIG_BH1749
	bool "Use BH1749 (light) sensor"
	default y if BOARD_THINGY91_NRF9160NS

config CONFIG_ADXL362
	bool "Use ADXL362 (motion) sensor"
	default y if BOARD_THINGY91_NRF9160NS

config UI_LED_PWM_FREQUENCY
	int "LED PWM frequency"
	range 100 1000000
	default 20000

endmenu

menu "Zephyr Kernel"
source "$ZEPHYR_BASE/Kconfig.zephyr"
endmenu

module = MAIN
module-str = MAIN
source "${ZEPHYR_BASE}/subsys/logging/Kconfig.template.log_config"
```

## west.yml
```
manifest:
  remotes:
    - name: nordic
      url-base: https://github.com/nrfconnect
  projects:
    - name: sdk-nrf
      path: nrf
      remote: nordic
      revision: v1.4.0
      import: true
  self:
    path: telenor-coap
```

## prj.conf
```kconfig
# General config
CONFIG_ASSERT=n

# Logging
CONFIG_LOG=y
CONFIG_LOG_STRDUP_MAX_STRING=64

# AT host library
CONFIG_AT_HOST_LIBRARY=y
CONFIG_AT_CMD_THREAD_STACK_SIZE=2048
CONFIG_UART_INTERRUPT_DRIVEN=y

# Network
CONFIG_MODEM_INFO=y
CONFIG_NETWORKING=y
CONFIG_NET_SOCKETS=y
CONFIG_NET_SOCKETS_OFFLOAD=y

# LTE link control
CONFIG_LTE_LINK_CONTROL=y
CONFIG_LTE_AUTO_INIT_AND_CONNECT=y
CONFIG_LTE_PDP_CMD=y
CONFIG_LTE_PDP_CONTEXT="0,\"IP\",\"telenor.iotgw\""

# CoAP
CONFIG_COAP=y
CONFIG_COAP_UTILS=y

# BSD library
CONFIG_BSD_LIBRARY=y
CONFIG_BSD_LIBRARY_TRACE_ENABLED=n

# Sensors
CONFIG_I2C=y
CONFIG_SENSOR=y
CONFIG_PWM=y

# LIBS, floating point support
CONFIG_NEWLIB_LIBC=y
CONFIG_NEWLIB_LIBC_NANO=n
CONFIG_XOROSHIRO_RANDOM_GENERATOR=y

# Heap and stacks
CONFIG_HEAP_MEM_POOL_SIZE=16384
CONFIG_MAIN_STACK_SIZE=8192
CONFIG_SYSTEM_WORKQUEUE_STACK_SIZE=8192
CONFIG_HW_STACK_PROTECTION=y

# Disable native network stack to save some memory
CONFIG_NET_IPV4=n
CONFIG_NET_IPV6=n
CONFIG_NET_UDP=n
CONFIG_NET_TCP=n
CONFIG_NET_RX_STACK_SIZE=5120
CONFIG_NET_TX_STACK_SIZE=2048

# Build without bootloader
CONFIG_BOOTLOADER_MCUBOOT=y

# Debug
CONFIG_NO_OPTIMIZATIONS=n
CONFIG_DEBUG=n
```

## prj_thingy91_nrf9160ns.overlay
```dts
# Sensors
# CONFIG_SENSOR_SIM=n
CONFIG_BME680=y
CONFIG_BH1749=y
CONFIG_ADXL362=y
```

## src/main.c
```c
/**
 *  Copyright (c) 2020 Telenor Norway ASA
 *  Author: Pontus Aurdal <pontus.aurdal@telenor.com>
 * 
 *  Licensed under the Apache License, Version 2.0 (the "License");
 *  you may not use this file except in compliance with the License.
 *  You may obtain a copy of the License at
 *
 *      http://www.apache.org/licenses/LICENSE-2.0
 *
 *  Unless required by applicable law or agreed to in writing, software
 *  distributed under the License is distributed on an "AS IS" BASIS,
 *  WITHOUT WARRANTIES OR CONDITIONS OF ANY KIND, either express or implied.
 *  See the License for the specific language governing permissions and
 *  limitations under the License.
 */

#include <zephyr.h>
#include <stdio.h>
#include <net/coap.h>
#include <net/coap_utils.h>
#include <net/socket.h>
#include <logging/log.h>

#include "board.h"
#include "led.h"

#define LOG_LEVEL CONFIG_MAIN_LOG_LEVEL
LOG_MODULE_REGISTER(MAIN);

#define SEND_INTERVAL_MS 10000

static uint8_t coap_buffer[256];

static struct sockaddr_in remote_addr = {
  .sin_family = AF_INET,
  .sin_port = htons(CONFIG_COAP_SERVER_PORT)
};

int ccb(const struct coap_packet *response, struct coap_reply *reply, const struct sockaddr *from) {
  const uint8_t *payload;
  uint16_t payload_len;
  uint8_t temp_buf[16];

  payload = coap_packet_get_payload(response, &payload_len);

  snprintf(temp_buf, MAX(payload_len, sizeof(temp_buf)), "%s", payload);

  printk("CoAP response: code: 0x%x, payload: %s\n",
         coap_header_get_code(response), temp_buf);

  return 0;
}

void main(void) {
  int64_t next_send_time = SEND_INTERVAL_MS;
  int err;

  board_init();
  coap_init(AF_INET, NULL);

  led_set_effect(LED_PATTERN_NORMAL);
  LOG_INF("Board inited! %s", CONFIG_BOARD);

  net_addr_pton(AF_INET, CONFIG_COAP_SERVER_IP, &remote_addr.sin_addr);

  next_send_time = k_uptime_get();

  while (1) {

    if (k_uptime_get() >= next_send_time) {

      led_set_effect(LED_PATTERN_SENDING);

      board_dump_modem_message(coap_buffer, sizeof(coap_buffer));
      LOG_INF("Uplink payload (modem): %s", log_strdup((char *)coap_buffer));
      err = coap_send_request(COAP_METHOD_POST, (struct sockaddr *)&remote_addr,
                              NULL, coap_buffer, strlen(coap_buffer), ccb);

      board_dump_message(coap_buffer, sizeof(coap_buffer));
      LOG_INF("Uplink payload (sensor): %s", log_strdup((char *)coap_buffer));
      err = coap_send_request(COAP_METHOD_POST, (struct sockaddr *)&remote_addr,
                              NULL, coap_buffer, strlen(coap_buffer), ccb);

      k_sleep(K_MSEC(500));
      led_set_effect(LED_PATTERN_NORMAL);

      // Todo: make CoAP GET request
      err = coap_send_request(COAP_METHOD_GET, (struct sockaddr *)&remote_addr,
                              NULL, NULL, 0, &ccb);
      LOG_INF("GET request");

      next_send_time += SEND_INTERVAL_MS;
    }

    int64_t remaining = next_send_time - k_uptime_get();
    if (remaining < 0) {
      remaining = 0;
    }
    k_sleep(K_MSEC(remaining));
  }
}
```

## src/board.c
```c
#include <stdio.h>

#include <zephyr.h>
#include <logging/log.h>

#include "board.h"
#include "modem.h"
#include "env_sensor.h"
#include "light_sensor.h"
#include "motion_sensor.h"
#include "led.h"

#define LOG_LEVEL CONFIG_BOARD_LOG_LEVEL
LOG_MODULE_REGISTER(BOARD);

enum {
  MESSAGE_MODEM,
  MESSAGE_SENSORS,
};

static MESSAGE last_message;

void board_init() {
  LOG_INF("Initialising board");

  modem_init();

  if (NULL == env_sensor_init()) {
    LOG_INF("Unable to initialize environment sensor, falling back to simulated sensor.");
  }

  if (NULL == light_sensor_init()) {
    LOG_INF("Unable to initialize light sensor, falling back to simulated sensor.");
  }

  if (NULL == motion_sensor_init()) {
    LOG_INF("Unable to initialize motion sensor, falling back to simulated sensor.");
  }

  if (NULL == led_init()) {
    LOG_INF("Unable to initialize LED, darkness follows.");
  }

}

void board_dump_modem_message(uint8_t *buffer, int len) {

  modem_sample(&last_message.modem);
  last_message.uptime = k_uptime_get() / 1000;

  snprintf(buffer, len, "%d,%lld,%d,%d,%s,%d,%d,%s,%s,%s,%d,%d",
    MESSAGE_MODEM,
    last_message.uptime,
    last_message.modem.current_band,
    last_message.modem.area_code,
    last_message.modem.current_operator,
    last_message.modem.mcc,
    last_message.modem.mnc,
    last_message.modem.cellid_hex,
    last_message.modem.ip_address,
    last_message.modem.modem_fw,
    last_message.modem.battery,
    last_message.modem.imei);
}

void board_dump_message(uint8_t *buffer, int len) {

  env_sensor_sample(&last_message.env_sensor);
  light_sensor_sample(&last_message.light_sensor);
  motion_sensor_sample(&last_message.motion_sensor);
  last_message.uptime = k_uptime_get() / 1000;

  snprintf(buffer, len, "%d,%lld,%.2f,%.2f,%.2f,%.2f,%d,%d,%d,%d,%d,%d,%d",
    MESSAGE_SENSORS,
    last_message.uptime,
    last_message.env_sensor.temperature,
    last_message.env_sensor.humidity,
    last_message.env_sensor.pressure,
    last_message.env_sensor.gas_res,
    last_message.light_sensor.red,
    last_message.light_sensor.green,
    last_message.light_sensor.blue,
    last_message.light_sensor.ir,
    last_message.motion_sensor.x,
    last_message.motion_sensor.y,
    last_message.motion_sensor.z);
}
```

## src/board.h
```c
#pragma once

#include "modem.h"
#include "env_sensor.h"
#include "light_sensor.h"
#include "motion_sensor.h"

typedef struct {
  modem_t modem;
  env_sensor_t env_sensor;
  light_sensor_t light_sensor;
  motion_sensor_t motion_sensor;
  int64_t uptime;
} MESSAGE;

void board_init(void);

void board_dump_modem_message(uint8_t *buffer, int len);
void board_dump_message(uint8_t *buffer, int len);
```

## src/env_sensor.c
```c
#include <zephyr.h>
#include <device.h>
#include <drivers/sensor.h>
#include <logging/log.h>

#include "env_sensor.h"
#include "util.h"

#define LOG_LEVEL CONFIG_ENV_SENSOR_LOG_LEVEL
LOG_MODULE_REGISTER(ENV_SENSOR);

static const struct device *env_dev = NULL;

const struct device *env_sensor_init() {

  if (!env_dev) {

    if (IS_ENABLED(CONFIG_BME680)) {
      env_dev = device_get_binding(ENV_DEV);

      if (!env_dev) {
        LOG_WRN("Device driver not found");
        return NULL;
      }

      return env_dev;
    }
  }

  return NULL;
}

void env_sensor_sample(env_sensor_t *env_sensor) {
  int err;

  // Null out
  env_sensor->temperature = 0.0;
  env_sensor->humidity    = 0.0;
  env_sensor->pressure    = 0.0;
  env_sensor->gas_res     = 0.0;

  // Simulate
  if (env_dev == NULL) {
    env_sensor->temperature = rand_float(20.0, 29.0);
    env_sensor->humidity    = rand_float(40, 45);
    env_sensor->pressure    = rand_float(98, 99);
    env_sensor->gas_res     = rand_float(21980, 22000);

  } else {
    struct sensor_value temperature, pressure, humidity, gas_res;

    err = sensor_sample_fetch(env_dev);
    if (err == 0) {
      sensor_channel_get(env_dev, SENSOR_CHAN_AMBIENT_TEMP, &temperature);
      sensor_channel_get(env_dev, SENSOR_CHAN_PRESS, &pressure);
      sensor_channel_get(env_dev, SENSOR_CHAN_HUMIDITY, &humidity);
      sensor_channel_get(env_dev, SENSOR_CHAN_GAS_RES, &gas_res);

      env_sensor->temperature = sensor_value_to_double(&temperature);
      env_sensor->humidity    = sensor_value_to_double(&humidity);
      env_sensor->pressure    = sensor_value_to_double(&pressure);
      env_sensor->gas_res     = sensor_value_to_double(&gas_res);
    }
  }
}
```

## src/env_sensor.h
```c
#pragma once

#include <device.h>

// #define ENV_DEV DT_LABEL(DT_INST(0, bosch_bme680))
#define ENV_DEV "BME680"

typedef struct {
  float temperature;
  float humidity;
  float pressure;
  float gas_res;
} env_sensor_t;

const struct device *env_sensor_init();

void env_sensor_sample(env_sensor_t *env_sensor);
```

## src/led.c
```c
#include <zephyr.h>
#include <device.h>
#include <drivers/pwm.h>
#include <logging/log.h>

#include "led.h"

#define LOG_LEVEL CONFIG_LED_LOG_LEVEL
LOG_MODULE_REGISTER(LED);

static led_t led;
static const size_t led_pins[3] = {
  LED_RED_PIN,
  LED_GREEN_PIN,
  LED_BLUE_PIN,
};
static struct led_effect effects[] = {
  [LED_PATTERN_NORMAL] = LED_EFFECT_LED_BREATHE(500, 500, LED_COLOR_CYAN),
  [LED_PATTERN_SENDING] = LED_EFFECT_LED_BLINK(200, LED_COLOR_GREEN),
};

static void pwm_out(led_t *led, struct led_color *color) {
  for (size_t i = 0; i < ARRAY_SIZE(color->c); i++) {
    pwm_pin_set_usec(led->pwm_dev, led_pins[i],
      (1000000 / CONFIG_UI_LED_PWM_FREQUENCY),
      color->c[i], 0);
  }
}

/*
static void pwm_off(led_t *led) {
  struct led_color nocolor = {0};

  pwm_out(led, &nocolor);
}
*/

static void work_handler(struct k_work *work) {
  led_t *w_led = CONTAINER_OF(work, led_t, work);
  const struct led_effect_step *effect_step =
    &led.effect->steps[led.effect_step];
  int substeps_left = effect_step->substep_count - led.effect_substep;

  for (size_t i = 0; i < ARRAY_SIZE(led.color.c); i++) {
    int diff = (effect_step->color.c[i] - led.color.c[i]) /
      substeps_left;
    led.color.c[i] += diff;
  }

  pwm_out(w_led, &led.color);

  led.effect_substep++;
  if (led.effect_substep == effect_step->substep_count) {
    led.effect_substep = 0;
    led.effect_step++;

    if (led.effect_step == led.effect->step_count) {
      if (led.effect->loop_forever) {
        led.effect_step = 0;
      }
    } else {
      __ASSERT_NO_MSG(led.effect->steps[led.effect_step].substep_count > 0);
    }
  }

  if (led.effect_step < led.effect->step_count) {
    int32_t next_delay =
      led.effect->steps[led.effect_step].substep_time;

    k_delayed_work_submit(&led.work, K_MSEC(next_delay));
  }
}

static void led_update(led_t *c_led) {
  k_delayed_work_cancel(&c_led->work);

  c_led->effect_step = 0;
  c_led->effect_substep = 0;

  if (!c_led->effect) {
    LOG_DBG("No effect set");
    return;
  }

  __ASSERT_NO_MSG(c_led->effect->steps);

  if (c_led->effect->step_count > 0) {
    int32_t next_delay =
      c_led->effect->steps[c_led->effect_step].substep_time;

    k_delayed_work_submit(&c_led->work, K_MSEC(next_delay));
  } else {
    LOG_DBG("LED effect with no effect");
  }
}

const struct device *led_init() {

  if (!led.pwm_dev) {

    led.pwm_dev = device_get_binding(LED_DEV);

    if (!led.pwm_dev) {
      LOG_WRN("Device driver not found");
      return NULL;
    }

    k_delayed_work_init(&led.work, work_handler);
    led_update(&led);

    return led.pwm_dev;
  }

  return NULL;

}

void led_set_effect(enum led_pattern pattern) {
  led.effect = &effects[pattern];
  led_update(&led);
}
```

## src/led.h
```c
#pragma once

#include <device.h>

#define LED_DEV "PWM_0"

#define LED_RED_PIN   29
#define LED_GREEN_PIN 30
#define LED_BLUE_PIN  31

struct led_color {
  uint8_t c[3];
};

struct led_effect_step {
  struct led_color color;
  uint16_t substep_count;
  uint16_t substep_time;
};

struct led_effect {
  struct led_effect_step *steps;
  uint16_t step_count;
  bool loop_forever;
};

typedef struct {
  const struct device *pwm_dev;

  size_t id;
  struct led_color color;
  const struct led_effect *effect;
  uint16_t effect_step;
  uint16_t effect_substep;

  struct k_delayed_work work;
} led_t;

#define LED_COLOR(_r, _g, _b) { \
  .c = {_r, _g, _b}             \
}
#define LED_NOCOLOR() {         \
  .c = {0, 0, 0}                \
}

#define LED_EFFECT_LED_ON(_color) {             \
  .steps = ((struct led_effect_step[]) {        \
    {                                           \
      .color = _color,                          \
      .substep_count = 1,                       \
      .substep_time = 0,                        \
    },                                          \
  }),                                           \
  .step_count = 1,                              \
  .loop_forever = false,                        \
}

#define LED_EFFECT_LED_BLINK(_period, _color) { \
  .steps = ((struct led_effect_step[]) {        \
    {                                           \
      .color = _color,                          \
      .substep_count = 1,                       \
      .substep_time = (_period),                \
    },                                          \
    {                                           \
      .color = LED_NOCOLOR(),                   \
      .substep_count = 1,                       \
      .substep_time = (_period),                \
    },                                          \
  }),                                           \
  .step_count = 2,                              \
  .loop_forever = true,                         \
}

#define _BREATH_SUBSTEPS 15
#define _BREATH_PAUSE_SUBSTEPS 1
#define LED_EFFECT_LED_BREATHE(_period, _pause, _color) { \
  .steps = ((struct led_effect_step[]) {                  \
    {                                                     \
      .color = _color,                                    \
      .substep_count = _BREATH_SUBSTEPS,                  \
      .substep_time = ((_period +                         \
        (_BREATH_SUBSTEPS - 1))                           \
        / _BREATH_SUBSTEPS),                              \
    },                                                    \
    {                                                     \
      .color = _color,                                    \
      .substep_count = 1,                                 \
      .substep_time = _period,                            \
    },                                                    \
    {                                                     \
      .color = LED_NOCOLOR(),                             \
      .substep_count = _BREATH_SUBSTEPS,                  \
      .substep_time = ((_period +                         \
        (_BREATH_SUBSTEPS - 1))                           \
        / _BREATH_SUBSTEPS),                              \
    },                                                    \
    {                                                     \
      .color = LED_NOCOLOR(),                             \
      .substep_count = _BREATH_PAUSE_SUBSTEPS,            \
      .substep_time = _pause,                             \
    },                                                    \
  }),                                                     \
  .step_count = 4,                                        \
  .loop_forever = true,                                   \
}

#define LED_EFFECT_LED_OFF() LED_EFFECT_LED_ON(LED_NOCOLOR())

#define LED_MAX           50
#define LED_COLOR_OFF     LED_COLOR(0, 0, 0)
#define LED_COLOR_RED     LED_COLOR(LED_MAX, 0, 0)
#define LED_COLOR_GREEN   LED_COLOR(0, LED_MAX, 0)
#define LED_COLOR_BLUE    LED_COLOR(0, 0, LED_MAX)
#define LED_COLOR_WHITE   LED_COLOR(LED_MAX, LED_MAX, LED_MAX)
#define LED_COLOR_YELLOW  LED_COLOR(LED_MAX, LED_MAX, 0)
#define LED_COLOR_CYAN    LED_COLOR(0, LED_MAX, LED_MAX)
#define LED_COLOR_PURPLE  LED_COLOR(LED_MAX, 0, LED_MAX)

enum led_pattern {
  LED_PATTERN_NORMAL,
  LED_PATTERN_SENDING,
};

const struct device *led_init();

void led_set_effect(enum led_pattern pattern);
```

## src/light_sensor.c
```c
#include <zephyr.h>
#include <device.h>
#include <drivers/sensor.h>
#include <logging/log.h>

#include "light_sensor.h"
#include "util.h"

#define LOG_LEVEL CONFIG_LIGHT_SENSOR_LOG_LEVEL
LOG_MODULE_REGISTER(LIGHT_SENSOR);

static const struct device *light_dev = NULL;

const struct device *light_sensor_init() {

  if (!light_dev) {

    if (IS_ENABLED(CONFIG_BH1749)) {
      light_dev = device_get_binding(LIGHT_DEV);

      if (!light_dev) {
        LOG_WRN("Device driver not found");
        return NULL;
      }

      return light_dev;
    }
  }

  return NULL;
}

void light_sensor_sample(light_sensor_t *light_sensor) {
  int err;

  // Null out
  light_sensor->red   = 0;
  light_sensor->green = 0;
  light_sensor->blue  = 0;
  light_sensor->ir    = 0;

  // Simulate
  if (light_dev == NULL) {
    light_sensor->red   = rand_int(500, 1000);
    light_sensor->green = rand_int(500, 1000);
    light_sensor->blue  = rand_int(500, 1000);
    light_sensor->ir    = rand_int(500, 1000);

  } else {
    struct sensor_value red, green, blue, ir;

    err = sensor_sample_fetch(light_dev);
    if (err == 0) {
      sensor_channel_get(light_dev, SENSOR_CHAN_RED, &red);
      sensor_channel_get(light_dev, SENSOR_CHAN_GREEN, &green);
      sensor_channel_get(light_dev, SENSOR_CHAN_BLUE, &blue);
      sensor_channel_get(light_dev, SENSOR_CHAN_IR, &ir);

      light_sensor->red   = sensor_value_to_double(&red);
      light_sensor->green = sensor_value_to_double(&green);
      light_sensor->blue  = sensor_value_to_double(&blue);
      light_sensor->ir    = sensor_value_to_double(&ir);
    }
  }
}
```

## src/light_sensor.h
```c
#pragma once

#include <device.h>

// #define ENV_DEV DT_LABEL(DT_INST(0, bosch_bme680))
#define LIGHT_DEV "BH1749"

typedef struct {
  int32_t red;
  int32_t green;
  int32_t blue;
  int32_t ir;
} light_sensor_t;

const struct device *light_sensor_init();

void light_sensor_sample(light_sensor_t *light_sensor);
```

## src/modem.c
```c
#include <zephyr.h>
#include <modem/lte_lc.h>
#include <modem/modem_info.h>
#include <logging/log.h>

#include "modem.h"

#define LOG_LEVEL CONFIG_MODEM_LOG_LEVEL
LOG_MODULE_REGISTER(MODEM);

struct modem_param_info modem_param;

void modem_init() {
  int err;

#if defined(CONFIG_LTE_LINK_CONTROL)
  if (!IS_ENABLED(CONFIG_LTE_AUTO_INIT_AND_CONNECT)) {
    LOG_INF("LTE Link Connecting...");
    err = lte_lc_init_and_connect();
    __ASSERT(err == 0, "LTE link could not be established.");
    LOG_INF("LTE Link Connected!");
  }
#endif /* defined(CONFIG_LTE_LINK_CONTROL) */

  err = modem_info_init();
  __ASSERT(err == 0, "Modem info module could not be initialized.");
  err = modem_info_params_init(&modem_param);
  __ASSERT(err == 0, "Modem info parameter structure could not be initialized.");
}

void modem_sample(modem_t *modem) {
  int err;

  // Null out

  err = modem_info_params_get(&modem_param);
  if (err == 0) {
    modem->current_band = modem_param.network.current_band.value;
    modem->area_code = modem_param.network.area_code.value;
    memcpy(&modem->current_operator, &modem_param.network.current_operator.value_string, 100);
    modem->mcc = modem_param.network.mcc.value;
    modem->mnc = modem_param.network.mnc.value;
    memcpy(&modem->cellid_hex, &modem_param.network.cellid_hex.value_string, 100);
    memcpy(&modem->ip_address, &modem_param.network.ip_address.value_string, 100);
    memcpy(&modem->modem_fw, &modem_param.device.modem_fw.value_string, 100);
    modem->battery = modem_param.device.battery.value;
    modem->imei = modem_param.device.imei.value;
  }
}
```

## src/modem.h
```c
#pragma once

typedef struct {
  uint16_t current_band;
  uint16_t area_code;
  char current_operator[100];
  uint16_t mcc;
  uint16_t mnc;
  char cellid_hex[100];
  char ip_address[100];
  /*
  u16_t ue_mode;
  u16_t lte_mode;
  u16_t nbiot_mode;
  u16_t gps_mode;
  u16_t date_time;
  u16_t apn;
  u16_t cellid_dec;

  u16_t uicc;
  u16_t iccid;
  u16_t imsi;
  */

  char modem_fw[100];
  uint16_t battery;
  uint16_t imei;
} modem_t;

void modem_init();

void modem_sample(modem_t *modem);
```

## src/motion_sensor.c
```c
#include <zephyr.h>
#include <device.h>
#include <drivers/sensor.h>
#include <logging/log.h>

#include "motion_sensor.h"
#include "util.h"

#define LOG_LEVEL CONFIG_MOTION_SENSOR_LOG_LEVEL
LOG_MODULE_REGISTER(MOTION_SENSOR);

static const struct device *motion_dev = NULL;

const struct device *motion_sensor_init() {

  if (!motion_dev) {

    if (IS_ENABLED(CONFIG_ADXL362)) {
      motion_dev = device_get_binding(MOTION_DEV);

      if (!motion_dev) {
        LOG_WRN("Device driver not found");
        return NULL;
      }

      return motion_dev;
    }
  }

  return NULL;
}

void motion_sensor_sample(motion_sensor_t *motion_sensor) {
  int err;

  // Null out
  motion_sensor->x = 0;
  motion_sensor->y = 0;
  motion_sensor->z = 0;

  // Simulate
  if (motion_dev == NULL) {
    motion_sensor->x = rand_int(0, 360);
    motion_sensor->y = rand_int(0, 360);
    motion_sensor->z = rand_int(0, 360);

  } else {
    struct sensor_value accel_data[3];

    err = sensor_sample_fetch_chan(motion_dev, SENSOR_CHAN_ALL);
    if (err == 0) {
      sensor_channel_get(motion_dev, SENSOR_CHAN_ACCEL_X, &accel_data[0]);
      sensor_channel_get(motion_dev, SENSOR_CHAN_ACCEL_Y, &accel_data[1]);
      sensor_channel_get(motion_dev, SENSOR_CHAN_ACCEL_Z, &accel_data[2]);

      motion_sensor->x = sensor_value_to_double(&accel_data[0]);
      motion_sensor->y = sensor_value_to_double(&accel_data[1]);
      motion_sensor->z = sensor_value_to_double(&accel_data[2]);
    }
  }
}
```

## src/motion_sensor.h
```c
#pragma once

#include <device.h>

#define MOTION_DEV "ADXL362"

typedef struct {
	int32_t x;			/**< X-axis acceleration [m/s^2]. */
	int32_t y;			/**< y-axis acceleration [m/s^2]. */
	int32_t z;			/**< z-axis acceleration [m/s^2]. */
} motion_sensor_t;

const struct device *motion_sensor_init();

void motion_sensor_sample(motion_sensor_t *motion_sensor);
```
